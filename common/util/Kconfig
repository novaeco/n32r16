## sensor_node/Kconfig.projbuild
```kconfig
menu "Sensor Node Options"
    choice SENSOR_AMBIENT_SENSOR
        prompt "Ambient sensor type"
        default SENSOR_AMBIENT_SENSOR_SHT20
        help
            Select the ambient temperature and humidity sensing front-end attached to
            the primary I\u00b2C bus. The firmware provides dedicated drivers and
            filtering pipelines per sensor family and will synthesise demo data when
            no physical devices are detected.

    config SENSOR_AMBIENT_SENSOR_SHT20
        bool "Sensirion SHT20"

    config SENSOR_AMBIENT_TCA9548A_ENABLE
        bool "Use TCA9548A mux for dual SHT20"
        depends on SENSOR_AMBIENT_SENSOR_SHT20
        default y
        help
            Enable this option when both ambient channels are populated with SHT20 sensors.
            The firmware will drive a TCA9548A I\u00b2C multiplexer to expose the fixed-address
            sensors on distinct downstream buses, avoiding collisions on 0x40.

    config SENSOR_TCA9548A_ADDRESS
        hex "TCA9548A I2C address"
        depends on SENSOR_AMBIENT_TCA9548A_ENABLE
        range 0x70 0x77
        default 0x70

    config SENSOR_TCA9548A_CH0
        int "TCA9548A channel for ambient sensor #1"
        depends on SENSOR_AMBIENT_TCA9548A_ENABLE
        range 0 7
        default 0

    config SENSOR_TCA9548A_CH1
        int "TCA9548A channel for ambient sensor #2"
        depends on SENSOR_AMBIENT_TCA9548A_ENABLE
        range 0 7
        default 1

    config SENSOR_AMBIENT_SENSOR_BME280
        bool "Bosch BME280"

    endchoice

    config SENSOR_ONEWIRE_GPIO
        int "1-Wire bus GPIO"
        range 0 48
        default 8
        help
            GPIO used to interface the DS18B20 one-wire bus. Adjust when porting to
            ESP32-S3 modules with different pinouts.

    choice SENSOR_PWM_BACKEND_DRIVER
        prompt "PWM backend"
        default SENSOR_PWM_BACKEND_DRIVER_PCA9685
        help
            Select the PWM expansion peripheral used for actuator control.

    config SENSOR_PWM_BACKEND_DRIVER_PCA9685
        bool "NXP PCA9685 (I\u00b2C)"

    config SENSOR_PWM_BACKEND_DRIVER_TLC5947
        bool "TI TLC5947 (SPI)"

    config SENSOR_PWM_BACKEND_DRIVER_NONE
        bool "Disable external PWM backend"

    endchoice

    config SENSOR_PWM_BACKEND
        string "PWM backend identifier"
        default "pca9685" if SENSOR_PWM_BACKEND_DRIVER_PCA9685
        default "tlc5947" if SENSOR_PWM_BACKEND_DRIVER_TLC5947
        default "none" if SENSOR_PWM_BACKEND_DRIVER_NONE
        help
            String identifier for the selected PWM expansion backend. Exposed to the
            application for conditional logic and telemetry labelling.
    config SENSOR_ALLOW_PLACEHOLDER_SECRETS
        bool "Allow building with placeholder security material"
        default n
        help
            Enable this option only for development images where placeholder
            bearer tokens, provisioning POPs, and OTA manifest URLs remain
            configured. Production builds must provide unique values to avoid
            compilation failures enforced by app_main.c.

    config SENSOR_WS_PORT
        int "WebSocket server port"
        range 80 65535
        default 8080
    config SENSOR_WS_AUTH_TOKEN
        string "WebSocket bearer token"
        default "replace-me"
    config SENSOR_WS_ENABLE_ENCRYPTION
        bool "Encrypt WebSocket frames with AES-GCM"
        default n
    config SENSOR_WS_ENABLE_HANDSHAKE
        bool "Require HMAC handshake headers"
        default n
    config SENSOR_WS_CRYPTO_SECRET_BASE64
        string "WebSocket shared secret (Base64)"
        default ""
    config SENSOR_WS_HANDSHAKE_TTL_MS
        int "Handshake nonce retention window (ms)"
        range 1000 3600000
        default 300000
    config SENSOR_WS_HANDSHAKE_CACHE_SIZE
        int "Handshake nonce cache size"
        range 8 128
        default 32
    config SENSOR_PROV_SERVICE_NAME
        string "Provisioning service name suffix"
        default "SENSOR"
    config SENSOR_PROV_POP
        string "Provisioning proof-of-possession"
        default "sensor-pop"
    config SENSOR_PROV_SEC2_USERNAME
        string "Provisioning SRP username"
        default "wifiprov"
    config SENSOR_PROV_SEC2_SALT_BASE64
        string "Provisioning SRP salt (Base64)"
        default "A27gx7y57ahMnqyX2T3s9A=="
    config SENSOR_PROV_SEC2_VERIFIER_BASE64
        string "Provisioning SRP verifier (Base64)"
        default "fHyFR2UIlG3WNq831+iRQ3jP/WFsWdL4OQgScjjeniSkcCYc36kDwrJw57EyJNoRHZcY3GByCMyayQxIJ+KuiaoWJbgE0hqbOo839uQ6cS7hJ4Zurc4o/1RGYB+5lofcV0Cn1GzJd1TcFoLw7TVqxHCtPZC1gZRw17xlstUY4C7Dpflo3WR7uLc8nPwA2HF+t5p8sbfCwxg0KTJDPgCZ6YKU49gqsJYpt98OXwgzQHZSkTIAn5csiWw5HsgoBUQXP2gCip9EYdH1oX5acNLHI4HLOGjkLCC8QFd2F70IuJa8JusyRmk1BYwVcNkb6b7MqTimZ/CtUBMZcmS/UsI04hsReXRyvTRbseL9ZnP+cWR00E68USQZQIcOkkDmIectTjd2Ly7iaMeJ6DITQgaEhFNKswwbTI0cUZcZq653/9vs8BCVNDNryz6ED7nYX7iguFVTPnD3GPXOe06/J87OqLO+QMXFMik+cWSe3oz2daHm9lPIMah43lBA92LeNrK6"
    config SENSOR_PROV_TIMEOUT_MS
        int "Provisioning completion timeout (ms)"
        range 1000 600000
        default 180000
    config SENSOR_PROV_CONNECT_TIMEOUT_MS
        int "Wi-Fi connect attempt timeout (ms)"
        range 1000 120000
        default 20000
    config SENSOR_PROV_MAX_ATTEMPTS
        int "Maximum Wi-Fi connect attempts before failing"
        range 1 20
        default 5
    config SENSOR_PROV_PREFER_BLE
        bool "Préférer le schéma de provisioning BLE"
        default n
        help
            Active la tentative de provisioning via BLE (ESP BLE Provisioning).
            Lorsque le contrôleur Bluetooth est indisponible, le firmware
            bascule automatiquement vers le schéma SoftAP classique.
    config SENSOR_OTA_URL
        string "HTTPS OTA manifest URL"
        default "https://example.com/sensor/ota.json"
    config USE_CBOR
        bool "Enable CBOR payloads"
        default n
    config SENSOR_ENABLE_GCOV
        bool "Enable gcov instrumentation for unit tests"
        default n
        help
            Selecting this option appends "-fprofile-arcs -ftest-coverage" to the
            compilation and linking flags for the sensor node component. Enable it
            in CI or dedicated coverage builds before executing `idf.py -T` to
            generate `.gcda` files consumable by tools/run_coverage.py.
endmenu
```

## sensor_node/configs/esp32c3/sdkconfig.defaults
```kconfig
CONFIG_IDF_TARGET="esp32c3"
CONFIG_ESPTOOLPY_FLASHSIZE_4MB=y
CONFIG_ESPTOOLPY_FLASHFREQ_80M=y
CONFIG_ESPTOOLPY_FLASHMODE_DIO=y
CONFIG_ESP32C3_DEFAULT_CPU_FREQ_160=y
CONFIG_PARTITION_TABLE_CUSTOM=y
CONFIG_PARTITION_TABLE_FILENAME="../partitions/esp32c3_4MB.csv"
CONFIG_FREERTOS_UNICORE=y
```

## sensor_node/configs/esp32s2/sdkconfig.defaults
```kconfig
CONFIG_IDF_TARGET="esp32s2"
CONFIG_ESPTOOLPY_FLASHSIZE_8MB=y
CONFIG_ESPTOOLPY_FLASHFREQ_80M=y
CONFIG_ESPTOOLPY_FLASHMODE_QIO=y
CONFIG_ESP32S2_DEFAULT_CPU_FREQ_240=y
CONFIG_PARTITION_TABLE_CUSTOM=y
CONFIG_PARTITION_TABLE_FILENAME="../partitions/esp32s2_8MB.csv"
CONFIG_SPIRAM_USE_CAPS_ALLOC=n
CONFIG_FREERTOS_UNICORE=y
```

## sensor_node/main/Kconfig.projbuild
```kconfig
menu "Sensor Node Configuration"

config SENSOR_NODE_WS_MAX_FRAME_SIZE
    int "Maximum WebSocket frame payload (bytes)"
    default 4096
    range 1024 16384
    help
        Upper bound for serialized sensor update frames broadcast over WebSocket.
        Should accommodate the largest expected JSON document including future
        extensions.

menu "Wi-Fi Provisioning"

config SENSOR_NODE_PROV_SERVICE_PREFIX
    string "SoftAP service name prefix"
    default "SENSOR"

config SENSOR_NODE_PROV_SERVICE_KEY
    string "SoftAP WPA2 passphrase"
    default "SensorSetup!"

config SENSOR_NODE_PROV_POP
    string "Provisioning proof-of-possession"
    default ""

config SENSOR_NODE_PROV_TIMEOUT_MS
    int "Provisioning timeout (ms)"
    default 300000
    range 60000 1800000

endmenu

menu "Command Authentication"

config SENSOR_NODE_CMD_AUTH_PARTITION
    string "NVS partition label"
    default "secrets"

config SENSOR_NODE_CMD_AUTH_NAMESPACE
    string "NVS namespace"
    default "command"

config SENSOR_NODE_CMD_AUTH_KEY
    string "NVS key name"
    default "hmac_key"

endmenu

endmenu
```

## sensor_node/sdkconfig.defaults
```kconfig
CONFIG_IDF_TARGET="esp32s3"
CONFIG_ESPTOOLPY_FLASHSIZE_32MB=y
CONFIG_ESPTOOLPY_FLASHFREQ_80M=y
CONFIG_ESPTOOLPY_FLASHMODE_OPI_DTR=y
CONFIG_SPIRAM_MODE_OCT=y
CONFIG_ESP32S3_SPIRAM_SUPPORT=y
CONFIG_SPIRAM_TYPE_AUTO=y
CONFIG_ESP32S3_DATA_CACHE_64KB=y
CONFIG_ESP32S3_INSTRUCTION_CACHE_64KB=y
CONFIG_SPIRAM_BOOT_INIT=y
CONFIG_SPIRAM_USE_CAPS_ALLOC=y
CONFIG_SPIRAM_MALLOC_ALWAYSINTERNAL=16384
CONFIG_SPIRAM_MALLOC_RESERVE_INTERNAL=32768
CONFIG_ESP32S3_DEFAULT_CPU_FREQ_240=y
CONFIG_FREERTOS_UNICORE=n
CONFIG_PARTITION_TABLE_CUSTOM=y
CONFIG_PARTITION_TABLE_FILENAME="../partitions/default_16MB_psram_32MB_flash_opi.csv"
CONFIG_WIFI_PROV_SCAN_MAX_ENTRIES=10
CONFIG_LWIP_LOCAL_HOSTNAME="sensor-node"
CONFIG_SENSOR_ALLOW_PLACEHOLDER_SECRETS=n
CONFIG_SENSOR_WS_PORT=8080
CONFIG_SENSOR_WS_AUTH_TOKEN="replace-me"
CONFIG_SENSOR_WS_ENABLE_ENCRYPTION=n
CONFIG_SENSOR_WS_ENABLE_HANDSHAKE=n
CONFIG_SENSOR_WS_CRYPTO_SECRET_BASE64=""
CONFIG_SENSOR_WS_ENABLE_TOTP=n
CONFIG_SENSOR_WS_TOTP_SECRET_BASE32=""
CONFIG_SENSOR_WS_TOTP_PERIOD_S=30
CONFIG_SENSOR_WS_TOTP_DIGITS=8
CONFIG_SENSOR_WS_TOTP_WINDOW=1
CONFIG_SENSOR_WS_HANDSHAKE_TTL_MS=300000
CONFIG_SENSOR_WS_HANDSHAKE_CACHE_SIZE=32
CONFIG_SENSOR_PROV_SERVICE_NAME="SENSOR"
CONFIG_SENSOR_PROV_POP="sensor-pop"
CONFIG_SENSOR_PROV_SEC2_USERNAME="wifiprov"
CONFIG_SENSOR_PROV_SEC2_SALT_BASE64="A27gx7y57ahMnqyX2T3s9A=="
CONFIG_SENSOR_PROV_SEC2_VERIFIER_BASE64="fHyFR2UIlG3WNq831+iRQ3jP/WFsWdL4OQgScjjeniSkcCYc36kDwrJw57EyJNoRHZcY3GByCMyayQxIJ+KuiaoWJbgE0hqbOo839uQ6cS7hJ4Zurc4o/1RGYB+5lofcV0Cn1GzJd1TcFoLw7TVqxHCtPZC1gZRw17xlstUY4C7Dpflo3WR7uLc8nPwA2HF+t5p8sbfCwxg0KTJDPgCZ6YKU49gqsJYpt98OXwgzQHZSkTIAn5csiWw5HsgoBUQXP2gCip9EYdH1oX5acNLHI4HLOGjkLCC8QFd2F70IuJa8JusyRmk1BYwVcNkb6b7MqTimZ/CtUBMZcmS/UsI04hsReXRyvTRbseL9ZnP+cWR00E68USQZQIcOkkDmIectTjd2Ly7iaMeJ6DITQgaEhFNKswwbTI0cUZcZq653/9vs8BCVNDNryz6ED7nYX7iguFVTPnD3GPXOe06/J87OqLO+QMXFMik+cWSe3oz2daHm9lPIMah43lBA92LeNrK6"
CONFIG_SENSOR_PROV_TIMEOUT_MS=180000
CONFIG_SENSOR_PROV_CONNECT_TIMEOUT_MS=20000
CONFIG_SENSOR_PROV_MAX_ATTEMPTS=5
CONFIG_SENSOR_OTA_URL="https://example.com/sensor/ota.json"
CONFIG_BOOTLOADER_APP_ROLLBACK_ENABLE=y
CONFIG_OTA_ALLOW_HTTP=0
CONFIG_LOG_DEFAULT_LEVEL_INFO=y
CONFIG_ESP_SYSTEM_PANIC_PRINT_HALT=y
```
