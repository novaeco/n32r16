## common/util/Kconfig
```kconfig
menu "Common Components Options"
    config COMMON_ENABLE_GCOV
        bool "Enable gcov instrumentation for shared components"
        default n
        help
            Selecting this option appends "-fprofile-arcs -ftest-coverage" to the
            compilation and linking flags for all common components. Enable it in
            CI or dedicated coverage builds alongside project-specific coverage
            options before executing unit tests so that gcov artefacts are
            generated for aggregation by tools/run_coverage.py.
endmenu
```

## components/cert_store/Kconfig
```kconfig
menu "Certificate Store"
    config CERT_STORE_OVERRIDE_FROM_NVS
        bool "Load PEM overrides from NVS"
        default y
        help
            When enabled, cert_store will attempt to load PEM blobs from the
            configured NVS namespace before falling back to the built-in
            certificates.

    config CERT_STORE_NVS_PARTITION
        string "NVS partition label"
        depends on CERT_STORE_OVERRIDE_FROM_NVS
        default "nvs"
        help
            Partition label passed to nvs_open_from_partition(). Only change if
            the project stores certificate overrides in a custom partition.

    config CERT_STORE_NVS_NAMESPACE
        string "NVS namespace"
        depends on CERT_STORE_OVERRIDE_FROM_NVS
        default "cert_store"
        help
            Namespace containing the PEM blobs. Keys "server_cert",
            "server_key" and "ca_cert" are expected.

    config CERT_STORE_OVERRIDE_FROM_SPIFFS
        bool "Load PEM overrides from SPIFFS"
        default y
        help
            Attempt to mount the configured SPIFFS partition and read PEM files
            before falling back to the built-in certificates.

    config CERT_STORE_SPIFFS_PARTITION_LABEL
        string "SPIFFS partition label"
        depends on CERT_STORE_OVERRIDE_FROM_SPIFFS
        default "storage"
        help
            Partition label passed to esp_vfs_spiffs_register().

    config CERT_STORE_SPIFFS_MOUNT_POINT
        string "SPIFFS mount point"
        depends on CERT_STORE_OVERRIDE_FROM_SPIFFS
        default "/certs"
        help
            Base path where PEM files are located. cert_store reads
            server_cert.pem, server_key.pem and ca_cert.pem from this directory.
endmenu
```

## configs/esp32c3/sdkconfig.defaults
```kconfig
CONFIG_IDF_TARGET="esp32c3"
CONFIG_ESPTOOLPY_FLASHMODE_DIO=y
CONFIG_ESPTOOLPY_FLASHFREQ_80M=y
CONFIG_ESPTOOLPY_FLASHSIZE_4MB=y
CONFIG_PARTITION_TABLE_CUSTOM=y
CONFIG_PARTITION_TABLE_FILENAME="../partitions/esp32c3_4MB.csv"
CONFIG_COMPILER_OPTIMIZATION_SIZE=y
CONFIG_LWIP_LOCAL_HOSTNAME="sensor-node"
CONFIG_ESP32C3_DEFAULT_CPU_FREQ_160=y
```

## configs/esp32s2/sdkconfig.defaults
```kconfig
CONFIG_IDF_TARGET="esp32s2"
CONFIG_ESPTOOLPY_FLASHMODE_DIO=y
CONFIG_ESPTOOLPY_FLASHFREQ_80M=y
CONFIG_ESPTOOLPY_FLASHSIZE_8MB=y
CONFIG_PARTITION_TABLE_CUSTOM=y
CONFIG_PARTITION_TABLE_FILENAME="../partitions/esp32s2_8MB.csv"
CONFIG_ESP32S2_DEFAULT_CPU_FREQ_240=y
CONFIG_COMPILER_OPTIMIZATION_SIZE=y
CONFIG_LWIP_LOCAL_HOSTNAME="sensor-node"
CONFIG_ESP32S2_DATA_CACHE_LINE_64B=y
```

## hmi_node/Kconfig.projbuild
```kconfig
menu "HMI Node Options"
    config HMI_SENSOR_HOSTNAME
        string "Sensor fallback hostname"
        default "sensor-node.local"
    config HMI_ALLOW_PLACEHOLDER_SECRETS
        bool "Allow building with placeholder security material"
        default n
        help
            Enable this option only for development images where placeholder
            bearer tokens, provisioning POPs, and OTA manifest URLs remain.
            Production builds must disable it and provide unique credentials;
            compile-time assertions in app_main.c enforce the policy.

    config HMI_SENSOR_PORT
        int "Sensor WebSocket port"
        range 80 65535
        default 8080
    config HMI_DISCOVERY_TIMEOUT_MS
        int "mDNS discovery timeout before fallback (ms)"
        range 1000 60000
        default 12000
        help
            Defines the maximum time the HMI node waits for `_hmi-sensor._tcp`
            responses before falling back to the static hostname configured in
            `CONFIG_HMI_SENSOR_HOSTNAME`. Set to 0 to disable the timeout and
            rely solely on discovery retries.
    config HMI_DISCOVERY_CACHE_TTL_MINUTES
        int "mDNS discovery cache TTL (minutes)"
        range 1 1440
        default 120
        help
            Controls how long the cached endpoint from secure NVS is considered
            valid when discovery responses are unavailable. Once expired the HMI
            forces a fresh lookup before attempting connections.
    config HMI_WS_AUTH_TOKEN
        string "WebSocket bearer token"
        default "replace-me"
    config HMI_WS_ENABLE_ENCRYPTION
        bool "Encrypt WebSocket frames with AES-GCM"
        default n
    config HMI_WS_ENABLE_HANDSHAKE
        bool "Include HMAC handshake headers"
        default n
    config HMI_WS_CRYPTO_SECRET_BASE64
        string "WebSocket shared secret (Base64)"
        default ""
    config HMI_WS_TLS_SNI_OVERRIDE
        string "TLS server name override"
        default ""
        help
            When connecting to the sensor node over TLS the HMI advertises this
            value as Server Name Indication (SNI) and validates it against the
            certificate SubjectAltName. Leave empty to use the hostname returned
            by mDNS, the cached discovery metadata, or `CONFIG_HMI_SENSOR_HOSTNAME`.
    config HMI_PROV_SERVICE_NAME
        string "Provisioning service name suffix"
        default "HMI"
    config HMI_PROV_POP
        string "Provisioning proof-of-possession"
        default "hmi-pop"
    config HMI_PROV_SEC2_USERNAME
        string "Provisioning SRP username"
        default "wifiprov"
    config HMI_PROV_SEC2_SALT_BASE64
        string "Provisioning SRP salt (Base64)"
        default "A27gx7y57ahMnqyX2T3s9A=="
    config HMI_PROV_SEC2_VERIFIER_BASE64
        string "Provisioning SRP verifier (Base64)"
        default "fHyFR2UIlG3WNq831+iRQ3jP/WFsWdL4OQgScjjeniSkcCYc36kDwrJw57EyJNoRHZcY3GByCMyayQxIJ+KuiaoWJbgE0hqbOo839uQ6cS7hJ4Zurc4o/1RGYB+5lofcV0Cn1GzJd1TcFoLw7TVqxHCtPZC1gZRw17xlstUY4C7Dpflo3WR7uLc8nPwA2HF+t5p8sbfCwxg0KTJDPgCZ6YKU49gqsJYpt98OXwgzQHZSkTIAn5csiWw5HsgoBUQXP2gCip9EYdH1oX5acNLHI4HLOGjkLCC8QFd2F70IuJa8JusyRmk1BYwVcNkb6b7MqTimZ/CtUBMZcmS/UsI04hsReXRyvTRbseL9ZnP+cWR00E68USQZQIcOkkDmIectTjd2Ly7iaMeJ6DITQgaEhFNKswwbTI0cUZcZq653/9vs8BCVNDNryz6ED7nYX7iguFVTPnD3GPXOe06/J87OqLO+QMXFMik+cWSe3oz2daHm9lPIMah43lBA92LeNrK6"
    config HMI_PROV_TIMEOUT_MS
        int "Provisioning completion timeout (ms)"
        range 1000 600000
        default 180000
    config HMI_PROV_CONNECT_TIMEOUT_MS
        int "Wi-Fi connect attempt timeout (ms)"
        range 1000 120000
        default 20000
    config HMI_PROV_MAX_ATTEMPTS
        int "Maximum Wi-Fi connect attempts before failing"
        range 1 20
        default 5
    config HMI_PROV_PREFER_BLE
        bool "Préférer le schéma de provisioning BLE"
        default n
        help
            Active la tentative de provisioning via BLE (ESP BLE Provisioning).
            Si le contrôleur BLE n'est pas disponible ou échoue à
            s'initialiser, le provisioning SoftAP est utilisé en repli.
    config HMI_OTA_URL
        string "HTTPS OTA manifest URL"
        default "https://example.com/hmi/ota.json"
    config USE_CBOR
        bool "Enable CBOR payloads"
        default n
    config HMI_ENABLE_GCOV
        bool "Enable gcov instrumentation for unit tests"
        default n
        help
            Selecting this option appends "-fprofile-arcs -ftest-coverage" to the
            compilation and linking flags for the HMI node component. Enable it in
            CI or dedicated coverage builds before executing `idf.py -T` to
            generate `.gcda` files consumable by tools/run_coverage.py.
endmenu
```

## hmi_node/main/Kconfig.projbuild
```kconfig
menu "HMI Node Configuration"

menu "Wi-Fi Provisioning"

config HMI_NODE_PROV_SERVICE_PREFIX
    string "SoftAP service name prefix"
    default "HMI"

config HMI_NODE_PROV_SERVICE_KEY
    string "SoftAP WPA2 passphrase"
    default "HMISetup!"

config HMI_NODE_PROV_POP
    string "Provisioning proof-of-possession"
    default ""

config HMI_NODE_PROV_TIMEOUT_MS
    int "Provisioning timeout (ms)"
    default 300000
    range 60000 1800000

endmenu

endmenu
```

## hmi_node/sdkconfig.defaults
```kconfig
CONFIG_IDF_TARGET="esp32s3"
CONFIG_ESPTOOLPY_FLASHSIZE_32MB=y
CONFIG_ESPTOOLPY_FLASHFREQ_80M=y
CONFIG_ESPTOOLPY_FLASHMODE_OPI_DTR=y
CONFIG_SPIRAM_MODE_OCT=y
CONFIG_ESP32S3_SPIRAM_SUPPORT=y
CONFIG_SPIRAM_TYPE_AUTO=y
CONFIG_SPIRAM_BOOT_INIT=y
CONFIG_SPIRAM_USE_CAPS_ALLOC=y
CONFIG_ESP32S3_DATA_CACHE_64KB=y
CONFIG_ESP32S3_INSTRUCTION_CACHE_64KB=y
CONFIG_ESP32S3_DEFAULT_CPU_FREQ_240=y
CONFIG_PARTITION_TABLE_CUSTOM=y
CONFIG_PARTITION_TABLE_FILENAME="../partitions/default_16MB_psram_32MB_flash_opi.csv"
CONFIG_LWIP_LOCAL_HOSTNAME="hmi-node"
CONFIG_HMI_ALLOW_PLACEHOLDER_SECRETS=n
CONFIG_HMI_WS_AUTH_TOKEN="replace-me"
CONFIG_HMI_SENSOR_HOSTNAME="sensor-node.local"
CONFIG_HMI_SENSOR_PORT=8080
CONFIG_HMI_DISCOVERY_TIMEOUT_MS=12000
CONFIG_HMI_DISCOVERY_CACHE_TTL_MINUTES=120
CONFIG_HMI_PROV_SERVICE_NAME="HMI"
CONFIG_HMI_PROV_POP="hmi-pop"
CONFIG_HMI_PROV_SEC2_USERNAME="wifiprov"
CONFIG_HMI_PROV_SEC2_SALT_BASE64="A27gx7y57ahMnqyX2T3s9A=="
CONFIG_HMI_PROV_SEC2_VERIFIER_BASE64="fHyFR2UIlG3WNq831+iRQ3jP/WFsWdL4OQgScjjeniSkcCYc36kDwrJw57EyJNoRHZcY3GByCMyayQxIJ+KuiaoWJbgE0hqbOo839uQ6cS7hJ4Zurc4o/1RGYB+5lofcV0Cn1GzJd1TcFoLw7TVqxHCtPZC1gZRw17xlstUY4C7Dpflo3WR7uLc8nPwA2HF+t5p8sbfCwxg0KTJDPgCZ6YKU49gqsJYpt98OXwgzQHZSkTIAn5csiWw5HsgoBUQXP2gCip9EYdH1oX5acNLHI4HLOGjkLCC8QFd2F70IuJa8JusyRmk1BYwVcNkb6b7MqTimZ/CtUBMZcmS/UsI04hsReXRyvTRbseL9ZnP+cWR00E68USQZQIcOkkDmIectTjd2Ly7iaMeJ6DITQgaEhFNKswwbTI0cUZcZq653/9vs8BCVNDNryz6ED7nYX7iguFVTPnD3GPXOe06/J87OqLO+QMXFMik+cWSe3oz2daHm9lPIMah43lBA92LeNrK6"
CONFIG_HMI_PROV_TIMEOUT_MS=180000
CONFIG_HMI_PROV_CONNECT_TIMEOUT_MS=20000
CONFIG_HMI_PROV_MAX_ATTEMPTS=5
CONFIG_HMI_OTA_URL="https://example.com/hmi/ota.json"
CONFIG_HMI_WS_TLS_SNI_OVERRIDE=""
CONFIG_BOOTLOADER_APP_ROLLBACK_ENABLE=y
CONFIG_OTA_ALLOW_HTTP=0
CONFIG_LV_COLOR_DEPTH_16=y
CONFIG_LV_USE_LOG=y
CONFIG_LV_LOG_LEVEL_WARN=y
CONFIG_ESP_SYSTEM_PANIC_PRINT_HALT=y
```
